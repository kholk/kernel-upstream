// SPDX-License-Identifier: GPL-2.0
/* Copyright (C) 2014 Sony Mobile Communications Inc.
 * Copyright (c) 2016-2019 AngeloGioacchino Del Regno <kholk11@gmail.com>
 */

/dts-v1/;

#include "msm8956-sony-xperia-loire.dtsi"
#include <dt-bindings/gpio/gpio.h>

/ {
	model = "Sony Xperia X (Loire Suzu)";
	compatible = "sony,xperia-suzu", "qcom,msm8956";

	qcom,msm-id = <266 0x10001>; /* MSM8956 PM/PMI8956 */
	qcom,board-id = <8 0>;
};
