## Documentation/devicetree/bindings/phy/qcom,snps-28nm-usb-hs-phy.txt
```
Qualcomm Synopsys 28nm Femto phy controller
===========================================

Synopsys 28nm femto phy controller supports LS/FS/HS usb connectivity on
Qualcomm chipsets.

Required properties:

- compatible:
    Value type: <string>
    Definition: Should contain "qcom,qcs404-usb-hsphy".

- reg:
    Value type: <prop-encoded-array>
    Definition: USB PHY base address and length of the register map.

- #phy-cells:
    Value type: <u32>
    Definition: Should be 0. See phy/phy-bindings.txt for details.

- clocks:
    Value type: <prop-encoded-array>
    Definition: See clock-bindings.txt section "consumers". List of
		three clock specifiers for reference, phy core and
		sleep clocks.

- clock-names:
    Value type: <string>
    Definition: Names of the clocks in 1-1 correspondence with the "clocks"
		property. Must contain "ref", "phy" and "sleep".

- resets:
    Value type: <prop-encoded-array>
    Definition: See reset.txt section "consumers". PHY reset specifiers
		for phy core and POR resets.

- reset-names:
    Value type: <string>
    Definition: Names of the resets in 1-1 correspondence with the "resets"
		property. Must contain "phy" and "por".

- vdd-supply:
    Value type: <phandle>
    Definition: phandle to the regulator VDD supply node.

- vdda1p8-supply:
    Value type: <phandle>
    Definition: phandle to the regulator 1.8V supply node.

- vdda3p3-supply:
    Value type: <phandle>
    Definition: phandle to the regulator 3.3V supply node.

- qcom,vdd-voltage-level:
    Value type: <prop-array>
    Definition: This is a list of three integer values <no min max> where
		each value corresponding to voltage corner in uV.

Optional child nodes:

- The link to the USB connector should be modeled using the OF graph bindings
  specified in bindings/graph.txt.

Example:

	phy@7a000 {
		compatible = "qcom,qcs404-usb-hsphy";
		reg = <0x7a000 0x200>;
		#phy-cells = <0>;
		clocks = <&rpmcc RPM_SMD_LN_BB_CLK>,
			 <&gcc GCC_USB_HS_PHY_CFG_AHB_CLK>,
			 <&gcc GCC_USB2A_PHY_SLEEP_CLK>;
		clock-names = "ref", "phy", "sleep";
		resets = <&gcc GCC_USB_HS_PHY_CFG_AHB_BCR>,
			 <&gcc GCC_USB2A_PHY_BCR>;
		reset-names = "phy", "por";
		vdd-supply = <&vreg_l4_1p2>;
		vdda1p8-supply = <&vreg_l5_1p8>;
		vdda3p3-supply = <&vreg_l12_3p3>;
		qcom,vdd-voltage-level = <0 1144000 1200000>;

		port {
			ep_usb_phy: endpoint {
				remote-endpoint = <&ep_usb_con>;
			};
		};
	};
```
